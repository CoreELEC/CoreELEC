## projects/Rockchip/devices/GameForce/packages/uinput_joystick/Config.in
```kconfig
config BR2_PACKAGE_UINPUT_JOYSTICK
	bool "Rockchip uinput joystick  for r602"
	help
	  Rockchip uinput joystick for r602.
```
